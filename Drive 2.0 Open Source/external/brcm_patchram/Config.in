## Drive 2.0 Open Source/external/brcm_patchram/Config.in
```kconfig
config BR2_PACKAGE_BRCM_PATCHRAM
    bool "brcm-patchram"
    help
      Broadcom patchram utility
```

## u-boot/board/ti/am335x/Kconfig
```kconfig
if TARGET_AM335X_EVM

config SYS_BOARD
	default "am335x"

config SYS_VENDOR
	default "ti"

config SYS_SOC
	default "am33xx"

config SYS_CONFIG_NAME
	default "am335x_evm"

config NOR
	bool "Support for NOR flash"
	help
	  The AM335x SoC supports having a NOR flash connected to the GPMC.
	  In practice this is seen as a NOR flash module connected to the
	  "memory cape" for the BeagleBone family.

config RECOVERY_MODE
	bool "Boot into USB recovery Mode"
	help
	  Force the device to boot into a USB recovery mode instead of booting
          up the normal OS.

config CMD_UPGRADE
	bool "Upgrade firmware"
	default n
	help
	  Use objects inside EXT4 partition, verify  their signature, check
	  security version and upgrade firmware.

source "board/ti/common/Kconfig"

endif
```
